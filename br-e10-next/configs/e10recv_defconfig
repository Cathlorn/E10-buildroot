## br-e10-next/configs/e10recv_defconfig
```kconfig
BR2_arm=y
BR2_arm926t=y
BR2_JLEVEL=4
BR2_OPTIMIZE_2=y
BR2_KERNEL_HEADERS_VERSION=y
BR2_DEFAULT_KERNEL_VERSION="2.6.38"
BR2_GCC_VERSION_4_6_X=y
BR2_TOOLCHAIN_BUILDROOT_LARGEFILE=y
BR2_TOOLCHAIN_BUILDROOT_INET_RPC=y
BR2_TARGET_GENERIC_HOSTNAME="recovery"
BR2_TARGET_GENERIC_ISSUE="E10 Recovery Image"
BR2_ROOTFS_DEVICE_CREATION_DYNAMIC_UDEV=y
BR2_ROOTFS_POST_BUILD_SCRIPT="./jc-postbuild-fs.sh"
BR2_BUSYBOX_VERSION_1_18_X=y
BR2_PACKAGE_BZIP2=y
BR2_PACKAGE_DBUS=y
BR2_PACKAGE_MTD=y
BR2_PACKAGE_UBOOT_TOOLS=y
BR2_PACKAGE_USBUTILS=y
BR2_PACKAGE_USBUTILS_ZLIB=y
BR2_PACKAGE_LZO=y
BR2_PACKAGE_EXPAT=y
BR2_PACKAGE_DROPBEAR=y
BR2_PACKAGE_IFPLUGD=y
BR2_PACKAGE_LRZSZ=y
BR2_PACKAGE_NCFTP=y
BR2_PACKAGE_PORTMAP=y
BR2_PACKAGE_DIALOG=y
BR2_PACKAGE_LOCKFILE_PROGS=y
BR2_PACKAGE_NANO=y
BR2_TARGET_ROOTFS_INITRAMFS=y
BR2_LINUX_KERNEL=y
BR2_LINUX_KERNEL_CUSTOM_VERSION=y
BR2_LINUX_KERNEL_CUSTOM_VERSION_VALUE="2.6.38"
BR2_LINUX_KERNEL_PATCH="http://jcu.homelinux.org/rrd/2.6.38-at91-jc.patch.gz"
BR2_LINUX_KERNEL_DEFCONFIG="connect-e10"
```

## br-e10-next/configs/e10web_defconfig
```kconfig
BR2_arm=y
BR2_arm926t=y
BR2_JLEVEL=4
BR2_OPTIMIZE_2=y
BR2_UCLIBC_VERSION_0_9_33=y
BR2_BINUTILS_VERSION_2_22=y
BR2_GCC_VERSION_4_6_X=y
BR2_ENABLE_LOCALE_PURGE=y
BR2_ENABLE_LOCALE_WHITELIST="C en_US"
BR2_TOOLCHAIN_BUILDROOT_LARGEFILE=y
BR2_TOOLCHAIN_BUILDROOT_INET_IPV6=y
BR2_TOOLCHAIN_BUILDROOT_INET_RPC=y
BR2_TOOLCHAIN_BUILDROOT_LOCALE=y
BR2_TOOLCHAIN_BUILDROOT_CXX=y
BR2_TOOLCHAIN_BUILDROOT_USE_SSP=y
BR2_TARGET_GENERIC_HOSTNAME="e10-nextc4b1-web"
BR2_TARGET_GENERIC_ISSUE="E10 Next build 20120220 web"
BR2_ROOTFS_DEVICE_CREATION_DYNAMIC_UDEV=y
BR2_ROOTFS_POST_BUILD_SCRIPT="./board/synapse/e10/post-build.sh"
BR2_PACKAGE_BUSYBOX_CONFIG="board/synapse/e10/busybox-1.19.x.config"
BR2_PACKAGE_RRDTOOL=y
BR2_PACKAGE_GPIO9260=y
BR2_PACKAGE_DBUS=y
BR2_PACKAGE_IOSTAT=y
BR2_PACKAGE_MTD=y
BR2_PACKAGE_PICOCOM=y
BR2_PACKAGE_SETSERIAL=y
BR2_PACKAGE_STATSERIAL=y
BR2_PACKAGE_SYSSTAT=y
BR2_PACKAGE_UBOOT_TOOLS=y
BR2_PACKAGE_UBOOT_TOOLS_MKIMAGE=y
BR2_PACKAGE_USB_MODESWITCH=y
BR2_PACKAGE_USB_MODESWITCH_DATA=y
BR2_PACKAGE_USBMOUNT=y
BR2_PACKAGE_USBUTILS=y
BR2_PACKAGE_USBUTILS_ZLIB=y
BR2_PACKAGE_PHP=y
BR2_PACKAGE_PHP_SAPI_CLI_CGI=y
BR2_PACKAGE_PHP_EXT_OPENSSL=y
BR2_PACKAGE_PHP_EXT_SIMPLEXML=y
BR2_PACKAGE_PHP_EXT_EXIF=y
BR2_PACKAGE_PHP_EXT_FTP=y
BR2_PACKAGE_PHP_EXT_GETTEXT=y
BR2_PACKAGE_PHP_EXT_GMP=y
BR2_PACKAGE_PHP_EXT_JSON=y
BR2_PACKAGE_PHP_EXT_READLINE=y
BR2_PACKAGE_PHP_EXT_NCURSES=y
BR2_PACKAGE_PHP_EXT_PCNTL=y
BR2_PACKAGE_PHP_EXT_SYSVMSG=y
BR2_PACKAGE_PHP_EXT_SYSVSEM=y
BR2_PACKAGE_PHP_EXT_SYSVSHM=y
BR2_PACKAGE_PHP_EXT_ZIP=y
BR2_PACKAGE_PHP_EXT_FILTER=y
BR2_PACKAGE_PHP_EXT_CALENDAR=y
BR2_PACKAGE_PHP_EXT_SQLITE=y
BR2_PACKAGE_PHP_EXT_SQLITE_UTF8=y
BR2_PACKAGE_PHP_EXT_PDO=y
BR2_PACKAGE_PHP_EXT_PDO_SQLITE=y
BR2_PACKAGE_PHP_EXT_PDO_MYSQL=y
BR2_PACKAGE_PYTHON=y
BR2_PACKAGE_PYTHON_BZIP2=y
BR2_PACKAGE_PYTHON_BSDDB=y
BR2_PACKAGE_PYTHON_CURSES=y
BR2_PACKAGE_PYTHON_PYEXPAT=y
BR2_PACKAGE_PYTHON_READLINE=y
BR2_PACKAGE_PYTHON_SSL=y
BR2_PACKAGE_PYTHON_SQLITE=y
BR2_PACKAGE_PYTHON_NETIFACES=y
BR2_PACKAGE_PYTHON_SERIAL=y
BR2_PACKAGE_TCL=y
# BR2_PACKAGE_TCL_SHLIB_ONLY is not set
BR2_PACKAGE_LZO=y
BR2_PACKAGE_OPENSSL_BIN=y
BR2_PACKAGE_SQLITE_READLINE=y
BR2_PACKAGE_LIBDAEMON=y
BR2_PACKAGE_BWM_NG=y
BR2_PACKAGE_CIFS_UTILS=y
BR2_PACKAGE_CUPS=y
BR2_PACKAGE_ETHTOOL=y
BR2_PACKAGE_IPERF=y
BR2_PACKAGE_IPROUTE2=y
BR2_PACKAGE_IPTABLES=y
BR2_PACKAGE_IW=y
BR2_PACKAGE_LRZSZ=y
BR2_PACKAGE_NCFTP=y
BR2_PACKAGE_NTP=y
BR2_PACKAGE_NTP_SNTP=y
BR2_PACKAGE_NTP_NTPDATE=y
BR2_PACKAGE_OPENSSH=y
BR2_PACKAGE_PORTMAP=y
BR2_PACKAGE_PPPD=y
BR2_PACKAGE_RSYNC=y
BR2_PACKAGE_WIRELESS_TOOLS=y
BR2_PACKAGE_WPA_SUPPLICANT=y
BR2_PACKAGE_WPA_SUPPLICANT_EAP=y
BR2_PACKAGE_WPA_SUPPLICANT_CLI=y
BR2_PACKAGE_WPA_SUPPLICANT_PASSPHRASE=y
BR2_PACKAGE_IPKG=y
BR2_PACKAGE_DIALOG=y
BR2_PACKAGE_FILE=y
BR2_PACKAGE_SCREEN=y
BR2_PACKAGE_HTOP=y
BR2_PACKAGE_NANO=y
# BR2_PACKAGE_NANO_TINY is not set
BR2_TARGET_ROOTFS_JFFS2=y
BR2_TARGET_ROOTFS_JFFS2_NANDFLASH_2K_128K=y
BR2_TARGET_ROOTFS_JFFS2_PAD=y
BR2_TARGET_ROOTFS_JFFS2_SUMMARY=y
BR2_TARGET_ROOTFS_UBIFS=y
BR2_TARGET_ROOTFS_UBI=y
BR2_TARGET_UBOOT=y
BR2_TARGET_UBOOT_BOARDNAME="e10"
BR2_TARGET_UBOOT_CUSTOM_PATCH_DIR="board/synapse/e10/uboot/"
BR2_LINUX_KERNEL=y
BR2_LINUX_KERNEL_SAME_AS_HEADERS=y
BR2_LINUX_KERNEL_PATCH="board/synapse/e10/linux-3.2.6-patches/*"
BR2_LINUX_KERNEL_USE_CUSTOM_CONFIG=y
BR2_LINUX_KERNEL_CUSTOM_CONFIG_FILE="board/synapse/e10/linux-3.2.6-config"
```

## br-e10-next/package/gpio9260/Config.in
```kconfig
config BR2_PACKAGE_GPIO9260
	bool "gpio9260"
	help
		gpio9260 is a program to interact with at91sam9260
		and 9g20 GPIOs. 
```

## br-e10-next/package/usb_modeswitch_data/Config.in
```kconfig
config BR2_PACKAGE_USB_MODESWITCH_DATA
	depends on BR2_PACKAGE_USB_MODESWITCH
	bool "usb_modeswitch_data"
	help
	  USB mode switch data
	  Contains udev rules and other device data
	  
	  http://www.draisberghof.de/usb_modeswitch/
```

## br-e10-recv/configs/e10recv_defconfig
```kconfig
BR2_arm=y
BR2_arm926t=y
BR2_JLEVEL=4
BR2_OPTIMIZE_2=y
BR2_KERNEL_HEADERS_VERSION=y
BR2_DEFAULT_KERNEL_VERSION="2.6.38"
BR2_GCC_VERSION_4_6_X=y
BR2_TOOLCHAIN_BUILDROOT_LARGEFILE=y
BR2_TOOLCHAIN_BUILDROOT_INET_RPC=y
BR2_TARGET_GENERIC_HOSTNAME="e10-recovery"
BR2_TARGET_GENERIC_ISSUE="E10 Recovery Image 20120110"
BR2_ROOTFS_DEVICE_CREATION_DYNAMIC_UDEV=y
BR2_ROOTFS_POST_BUILD_SCRIPT="board/synapse/e10/post-build.sh"
BR2_PACKAGE_BZIP2=y
BR2_PACKAGE_MTD=y
BR2_PACKAGE_UBOOT_TOOLS=y
BR2_PACKAGE_UBOOT_TOOLS_MKIMAGE=y
BR2_PACKAGE_DROPBEAR=y
BR2_PACKAGE_DROPBEAR_DISABLE_REVERSEDNS=y
BR2_PACKAGE_LRZSZ=y
BR2_PACKAGE_NCFTP=y
BR2_PACKAGE_PORTMAP=y
BR2_PACKAGE_DIALOG=y
BR2_PACKAGE_LOCKFILE_PROGS=y
BR2_PACKAGE_NANO=y
BR2_TARGET_ROOTFS_INITRAMFS=y
BR2_LINUX_KERNEL=y
BR2_LINUX_KERNEL_CUSTOM_VERSION=y
BR2_LINUX_KERNEL_CUSTOM_VERSION_VALUE="2.6.38"
BR2_LINUX_KERNEL_PATCH="http://jcu.homelinux.org/rrd/2.6.38-at91-jc.patch.gz"
BR2_LINUX_KERNEL_USE_CUSTOM_CONFIG=y
BR2_LINUX_KERNEL_CUSTOM_CONFIG_FILE="board/synapse/e10/linux-2.6.38-config"
```

## br1105-main/board/sw/e10/e10_defconfig
```kconfig
BR2_arm=y
BR2_ARM_OABI=y
BR2_CCACHE=y
BR2_HAVE_DOCUMENTATION=y
BR2_HAVE_DEVFILES=y
BR2_KERNEL_HEADERS_VERSION=y
BR2_DEFAULT_KERNEL_VERSION="2.6.38"
BR2_TOOLCHAIN_BUILDROOT_LARGEFILE=y
BR2_TOOLCHAIN_BUILDROOT_INET_RPC=y
BR2_TOOLCHAIN_BUILDROOT_LOCALE=y
BR2_TOOLCHAIN_BUILDROOT_PROGRAM_INVOCATION=y
BR2_TOOLCHAIN_BUILDROOT_CXX=y
BR2_ROOTFS_DEVICE_CREATION_DYNAMIC_UDEV=y
BR2_ROOTFS_DEVICE_TABLE="target/generic/device_table.txt target/generic/device_table_dev.txt"
BR2_PACKAGE_UDEV_UTILS=y
BR2_PACKAGE_UDEV_VOLUME_ID=y
BR2_PACKAGE_UDEV_SCSI_ID=y
BR2_PACKAGE_UDEV_PATH_ID=y
BR2_PACKAGE_UDEV_FIRMWARE_SH=y
BR2_PACKAGE_USB_MODESWITCH=y
BR2_PACKAGE_USBUTILS=y
BR2_PACKAGE_USBUTILS_ZLIB=y
BR2_PACKAGE_EXPAT=y
BR2_PACKAGE_NANO=y
BR2_LINUX_KERNEL=y
BR2_LINUX_KERNEL_CUSTOM_VERSION=y
BR2_LINUX_KERNEL_CUSTOM_VERSION_VALUE="2.6.38"
BR2_LINUX_KERNEL_PATCH="2.6.38-at91.patch"
BR2_LINUX_KERNEL_DEFCONFIG="connect-e10"
```

## br1105-main/configs/e10_defconfig
```kconfig
BR2_arm=y
BR2_arm926t=y
BR2_JLEVEL=4
BR2_DEPRECATED=y
BR2_KERNEL_HEADERS_VERSION=y
BR2_DEFAULT_KERNEL_VERSION="2.6.38"
BR2_GCC_VERSION_4_5_X=y
BR2_ENABLE_LOCALE_PURGE=y
BR2_ENABLE_LOCALE_WHITELIST="C en_US"
BR2_TOOLCHAIN_BUILDROOT_LARGEFILE=y
BR2_TOOLCHAIN_BUILDROOT_INET_IPV6=y
BR2_TOOLCHAIN_BUILDROOT_INET_RPC=y
BR2_TOOLCHAIN_BUILDROOT_LOCALE=y
BR2_TOOLCHAIN_BUILDROOT_PROGRAM_INVOCATION=y
BR2_TOOLCHAIN_BUILDROOT_CXX=y
BR2_TARGET_GENERIC_HOSTNAME="e10C7B3"
BR2_TARGET_GENERIC_ISSUE="E10 connect"
BR2_ROOTFS_DEVICE_CREATION_DYNAMIC_UDEV=y
BR2_ROOTFS_DEVICE_TABLE="target/generic/device_table.txt target/generic/device_table_dev.txt"
BR2_ROOTFS_POST_BUILD_SCRIPT="./jc-postbuild-fs.sh"
BR2_PACKAGE_LZOP=y
BR2_PACKAGE_XZ=y
BR2_PACKAGE_LSOF=y
BR2_PACKAGE_RRDTOOL=y
BR2_PACKAGE_DBUS=y
BR2_PACKAGE_EEPROG=y
BR2_PACKAGE_I2C_TOOLS=y
BR2_PACKAGE_IOSTAT=y
BR2_PACKAGE_MAKEDEVS=y
BR2_PACKAGE_MTD=y
BR2_PACKAGE_SETSERIAL=y
BR2_PACKAGE_SSHFS=y
BR2_PACKAGE_UDEV_UTILS=y
BR2_PACKAGE_UDEV_FIRMWARE_SH=y
BR2_PACKAGE_USB_MODESWITCH=y
BR2_PACKAGE_USBMOUNT=y
BR2_PACKAGE_USBUTILS=y
BR2_PACKAGE_USBUTILS_ZLIB=y
BR2_PACKAGE_LIBARCHIVE=y
BR2_PACKAGE_SQLITE_READLINE=y
BR2_PACKAGE_LIBFFI=y
BR2_PACKAGE_NCURSES_TARGET_PANEL=y
BR2_PACKAGE_NCURSES_TARGET_FORM=y
BR2_PACKAGE_NCURSES_TARGET_MENU=y
BR2_PACKAGE_NEWT=y
BR2_PACKAGE_BWM_NG=y
BR2_PACKAGE_CUPS=y
BR2_PACKAGE_ETHTOOL=y
BR2_PACKAGE_IFPLUGD=y
BR2_PACKAGE_IPERF=y
BR2_PACKAGE_IPTABLES=y
BR2_PACKAGE_IW=y
BR2_PACKAGE_LRZSZ=y
BR2_PACKAGE_NTP=y
BR2_PACKAGE_NTP_SNTP=y
BR2_PACKAGE_NTP_NTPDATE=y
BR2_PACKAGE_NTP_NTPDC=y
BR2_PACKAGE_NTP_NTPQ=y
BR2_PACKAGE_NTP_TICKADJ=y
BR2_PACKAGE_OPENVPN=y
BR2_PACKAGE_PORTMAP=y
BR2_PACKAGE_PPPD=y
BR2_PACKAGE_PPPD_FILTER=y
BR2_PACKAGE_PPTP_LINUX=y
BR2_PACKAGE_RSYNC=y
BR2_PACKAGE_WEBIF=y
BR2_PACKAGE_WEBIF_INSTALL_INDEX_HTML=y
BR2_PACKAGE_WIRELESS_TOOLS=y
BR2_PACKAGE_WIRELESS_TOOLS_LIB=y
BR2_PACKAGE_WPA_SUPPLICANT=y
BR2_PACKAGE_WPA_SUPPLICANT_EAP=y
BR2_PACKAGE_WPA_SUPPLICANT_CLI=y
BR2_PACKAGE_WPA_SUPPLICANT_PASSPHRASE=y
BR2_PACKAGE_IPKG=y
BR2_PACKAGE_AT=y
BR2_PACKAGE_DIALOG=y
BR2_PACKAGE_SCREEN=y
BR2_PACKAGE_HTOP=y
BR2_PACKAGE_NANO=y
BR2_PACKAGE_E10_INITD=y
BR2_PACKAGE_E10_PYTHON=y
BR2_PACKAGE_PPP_SCRIPTS=y
BR2_PACKAGE_MONIT=y
BR2_TARGET_ROOTFS_JFFS2=y
BR2_TARGET_ROOTFS_JFFS2_NANDFLASH_2K_128K=y
BR2_TARGET_ROOTFS_JFFS2_PAD=y
BR2_TARGET_ROOTFS_JFFS2_SUMMARY=y
BR2_TARGET_ROOTFS_UBIFS=y
BR2_TARGET_ROOTFS_UBI=y
BR2_LINUX_KERNEL=y
BR2_LINUX_KERNEL_SAME_AS_HEADERS=y
BR2_LINUX_KERNEL_PATCH="http://jcu.homelinux.org/rrd/2.6.38-at91-jc.patch.gz"
BR2_LINUX_KERNEL_DEFCONFIG="connect-e10"
```

## br1105-main/linux-defconfig
```kconfig
CONFIG_ARCH_AT91=y
CONFIG_MACH_E10=y
CONFIG_EXPERIMENTAL=y
# CONFIG_LOCALVERSION_AUTO is not set
# CONFIG_SWAP is not set
CONFIG_SYSVIPC=y
CONFIG_LOG_BUF_SHIFT=14
# CONFIG_UTS_NS is not set
# CONFIG_IPC_NS is not set
# CONFIG_USER_NS is not set
# CONFIG_PID_NS is not set
# CONFIG_NET_NS is not set
CONFIG_SLAB=y
CONFIG_MODULES=y
CONFIG_MODULE_UNLOAD=y
# CONFIG_BLK_DEV_BSG is not set
# CONFIG_IOSCHED_DEADLINE is not set
# CONFIG_IOSCHED_CFQ is not set
# CONFIG_SECCOMP is not set
CONFIG_PM=y
# CONFIG_CORE_DUMP_DEFAULT_ELF_HEADERS is not set
CONFIG_NET=y
CONFIG_PACKET=y
CONFIG_UNIX=y
CONFIG_INET=y
CONFIG_IP_PNP=y
CONFIG_IP_PNP_BOOTP=y
# CONFIG_INET_XFRM_MODE_TRANSPORT is not set
# CONFIG_INET_XFRM_MODE_TUNNEL is not set
# CONFIG_INET_XFRM_MODE_BEET is not set
# CONFIG_INET_LRO is not set
# CONFIG_IPV6 is not set
CONFIG_L2TP=y
CONFIG_VLAN_8021Q=y
CONFIG_CFG80211=y
# CONFIG_CFG80211_DEFAULT_PS is not set
CONFIG_LIB80211=y
CONFIG_MAC80211=y
CONFIG_WIMAX=y
CONFIG_UEVENT_HELPER_PATH="/sbin/hotplug"
CONFIG_DEVTMPFS=y
CONFIG_DEVTMPFS_MOUNT=y
CONFIG_MTD=y
CONFIG_MTD_CONCAT=y
CONFIG_MTD_PARTITIONS=y
CONFIG_MTD_CMDLINE_PARTS=y
CONFIG_MTD_CHAR=y
CONFIG_MTD_BLOCK=y
CONFIG_MTD_DATAFLASH=y
CONFIG_MTD_NAND=y
CONFIG_MTD_UBI=y
CONFIG_MTD_UBI_GLUEBI=m
CONFIG_BLK_DEV_LOOP=y
CONFIG_BLK_DEV_RAM=y
CONFIG_BLK_DEV_RAM_SIZE=8192
CONFIG_MISC_DEVICES=y
CONFIG_SCSI=y
CONFIG_BLK_DEV_SD=y
CONFIG_SCSI_MULTI_LUN=y
# CONFIG_SCSI_LOWLEVEL is not set
CONFIG_NETDEVICES=y
CONFIG_TUN=m
CONFIG_PHYLIB=y
CONFIG_NET_ETHERNET=y
# CONFIG_NETDEV_1000 is not set
# CONFIG_NETDEV_10000 is not set
CONFIG_AT76C50X_USB=m
CONFIG_USB_ZD1201=m
CONFIG_USB_NET_RNDIS_WLAN=m
CONFIG_RTL8187=y
CONFIG_ATH_COMMON=m
CONFIG_ATH9K_HTC=m
CONFIG_AR9170_USB=m
CONFIG_HOSTAP=m
CONFIG_P54_COMMON=m
CONFIG_P54_USB=m
CONFIG_RT2X00=y
CONFIG_RT2500USB=y
CONFIG_RT73USB=y
CONFIG_RT2800USB=y
CONFIG_ZD1211RW=m
CONFIG_WIMAX_I2400M_USB=m
CONFIG_USB_USBNET=y
CONFIG_USB_NET_CDCETHER=m
CONFIG_USB_NET_CDC_EEM=m
CONFIG_USB_NET_CDC_NCM=m
# CONFIG_USB_NET_NET1080 is not set
# CONFIG_USB_NET_CDC_SUBSET is not set
CONFIG_USB_NET_ZAURUS=m
CONFIG_USB_NET_INT51X1=m
CONFIG_USB_SIERRA_NET=m
CONFIG_PPP=y
CONFIG_PPP_ASYNC=m
CONFIG_PPP_SYNC_TTY=m
CONFIG_PPP_DEFLATE=m
CONFIG_PPP_BSDCOMP=m
CONFIG_PPP_MPPE=m
CONFIG_PPPOE=m
CONFIG_SLIP=m
CONFIG_SLIP_COMPRESSED=y
# CONFIG_INPUT_MOUSEDEV_PSAUX is not set
CONFIG_INPUT_MOUSEDEV_SCREEN_X=320
CONFIG_INPUT_MOUSEDEV_SCREEN_Y=240
CONFIG_INPUT_EVDEV=y
CONFIG_KEYBOARD_GPIO=y
# CONFIG_INPUT_MOUSE is not set
CONFIG_LEGACY_PTY_COUNT=16
CONFIG_HW_RANDOM=y
CONFIG_I2C=y
CONFIG_I2C_GPIO=y
CONFIG_SPI=y
CONFIG_SPI_SPIDEV=y
CONFIG_GPIOLIB=y
# CONFIG_HWMON is not set
CONFIG_HID_DRAGONRISE=y
CONFIG_HID_GYRATION=y
CONFIG_HID_TWINHAN=y
CONFIG_HID_NTRIG=y
CONFIG_HID_PANTHERLORD=y
CONFIG_HID_PETALYNX=y
CONFIG_HID_SAMSUNG=y
CONFIG_HID_SONY=y
CONFIG_HID_SUNPLUS=y
CONFIG_HID_GREENASIA=y
CONFIG_HID_SMARTJOYPLUS=y
CONFIG_HID_TOPSEED=y
CONFIG_HID_THRUSTMASTER=y
CONFIG_HID_ZEROPLUS=y
CONFIG_USB=y
CONFIG_USB_DEBUG=y
CONFIG_USB_ANNOUNCE_NEW_DEVICES=y
CONFIG_USB_DEVICEFS=y
# CONFIG_USB_DEVICE_CLASS is not set
CONFIG_USB_MON=y
CONFIG_USB_ACM=m
CONFIG_USB_PRINTER=m
CONFIG_USB_WDM=m
CONFIG_USB_STORAGE=y
CONFIG_USB_SERIAL=m
CONFIG_USB_SERIAL_GENERIC=y
CONFIG_USB_SERIAL_CP210X=m
CONFIG_USB_SERIAL_FTDI_SIO=m
CONFIG_USB_SERIAL_IPW=m
CONFIG_USB_SERIAL_MOTOROLA=m
CONFIG_USB_SERIAL_NAVMAN=m
CONFIG_USB_SERIAL_PL2303=m
CONFIG_USB_SERIAL_QCAUX=m
CONFIG_USB_SERIAL_QUALCOMM=m
CONFIG_USB_SERIAL_SPCP8X5=m
CONFIG_USB_SERIAL_SIERRAWIRELESS=m
CONFIG_USB_SERIAL_OPTION=m
CONFIG_MMC=y
CONFIG_LEDS_GPIO=y
CONFIG_LEDS_TRIGGER_TIMER=y
CONFIG_LEDS_TRIGGER_HEARTBEAT=y
CONFIG_RTC_CLASS=y
CONFIG_RTC_DRV_M41T80=y
# CONFIG_RTC_DRV_CMOS is not set
CONFIG_STAGING=y
# CONFIG_STAGING_EXCLUDE_BUILD is not set
CONFIG_EXT2_FS=y
CONFIG_EXT2_FS_XATTR=y
CONFIG_EXT3_FS=y
CONFIG_MSDOS_FS=y
CONFIG_VFAT_FS=y
CONFIG_TMPFS=y
CONFIG_JFFS2_FS=y
CONFIG_JFFS2_SUMMARY=y
CONFIG_CRAMFS=y
CONFIG_NFS_FS=y
CONFIG_NFS_V3=y
CONFIG_ROOT_NFS=y
# CONFIG_RPCSEC_GSS_KRB5 is not set
CONFIG_NLS_CODEPAGE_437=y
CONFIG_NLS_CODEPAGE_850=y
CONFIG_NLS_ISO8859_1=y
CONFIG_NLS_ISO8859_15=y
CONFIG_NLS_UTF8=y
# CONFIG_ENABLE_WARN_DEPRECATED is not set
CONFIG_FRAME_WARN=1024
# CONFIG_UNUSED_SYMBOLS is not set
# CONFIG_CRYPTO_ANSI_CPRNG is not set
# CONFIG_CRYPTO_HW is not set
CONFIG_CRC16=m
```

## br1105-main/package/e10_initd/Config.in
```kconfig
config BR2_PACKAGE_E10_INITD
	bool "e10_initd"
	help
	  Synapse Wireless Inc. E10 specific /etc/init.d scripts
```

## br1105-main/package/e10_python/Config.in
```kconfig
config BR2_PACKAGE_E10_PYTHON
	bool "e10_python"
	select BR2_PACKAGE_NCURSES
	select BR2_PACKAGE_BERKELEYDB
	select BR2_PACKAGE_EXPAT
	select BR2_PACKAGE_READLINE
	select BR2_PACKAGE_OPENSSL
	select BR2_PACKAGE_SQLITE
	select BR2_PACKAGE_GZIP
	select BR2_PACKAGE_BZIP2
	help
	  Python for the E10

	  http://www.python.org/
```

## br1105-main/package/monit/Config.in
```kconfig
config BR2_PACKAGE_MONIT
	bool "monit"
	help
	  Monitor processes, files, devices and remote systems
```

## br1105-main/package/ppp-scripts/Config.in
```kconfig
config BR2_PACKAGE_PPP_SCRIPTS
	bool "ppp-scripts"
	help
	  PPP chat scripts to aid in connecting to a cellular data network
```

## br1111-main/package/tcl/Config.in
```kconfig
config BR2_PACKAGE_TCL
	bool "tcl"
	help
	  TCL (Tool Command Language) is a simple textual language.

	  http://www.tcl.tk

if BR2_PACKAGE_TCL

config BR2_PACKAGE_TCL_TCLSH
	bool "install tclsh"
	help
	  Install tclsh, the TCL interpreter.

	  Takes ~14kb on top of the libraries.

config BR2_PACKAGE_TCL_DEL_ENCODINGS
	bool "delete encodings (saves 1.4Mb)"
	default y
	help
	  Delete encoding files for TCL. If your programs do not use
	  various tcl character recoding functions, you may safely
	  choose Y here.

	  It saves approx. 1.4 Mb of space.

endif
```

## br1111-main/package/usb_modeswitch_data/Config.in
```kconfig
config BR2_PACKAGE_USB_MODESWITCH_DATA
	select BR2_PACKAGE_USB_MODESWITCH
	select BR2_PACKAGE_TCL
	select BR2_PACKAGE_TCL_TCLSH
	bool "usb_modeswitch_data"
	help
	  USB mode switch data
	  Contains udev rules and events to allow usb_modeswitch to
	  function automatically
	  
	  http://www.draisberghof.de/usb_modeswitch/
```
