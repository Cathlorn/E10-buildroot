## br1202-main/package/python-cpython/Config.in
```kconfig
config BR2_PACKAGE_PYTHON_CPYTHON
	bool "python-cpython"
	depends on BR2_PACKAGE_PYTHON
	help
	  Cpython The Cython language makes writing C 
	  extensions for the Python language as easy as 
	  Python itself.

	  http://cython.org/
```

## br1202-main/package/python-pyftdi/Config.in
```kconfig
config BR2_PACKAGE_PYTHON_PYFTDI
	bool "python-pyftdi"
	depends on BR2_PACKAGE_PYTHON
	help
	  PyFtdi aims at providing a user-space driver for modern FTDI_ devices,
	  implemented in pure Python language.

	  http://pypi.python.org/pypi/pyftdi
```

## br1202-main/package/python-pyusb/Config.in
```kconfig
config BR2_PACKAGE_PYTHON_PYUSB
	bool "python-pyusb"
	depends on BR2_PACKAGE_PYTHON
	help
	  PyUSB provides USB access on the Python language.

	  http://sourceforge.net/projects/pyusb/
```
